## system/buildroot_packages/awesome/Config.in
```kconfig
config BR2_PACKAGE_AWESOME
	depends on BR2_PACKAGE_XORG7
	depends on BR2_INSTALL_LIBSTDCPP
	depends on BR2_PACKAGE_GLIBC
	select BR2_PACKAGE_IMLIB2
	select BR2_PACKAGE_IMLIB2_JPEG
	select BR2_PACKAGE_IMLIB2_PNG
	select BR2_PACKAGE_IMLIB2_GIF
	select BR2_PACKAGE_IMLIB2_TIFF
	select BR2_PACKAGE_XCB_PROTO
	select BR2_PACKAGE_CAIRO
	select BR2_PACKAGE_PANGO
	select BR2_PACKAGE_XCB_UTIL
	select BR2_PACKAGE_XCB_UTIL_IMAGE
	select BR2_PACKAGE_XCB_UTIL_KEYSYMS
	select BR2_PACKAGE_XCB_UTIL_WM
	select BR2_PACKAGE_LIBXDG_BASEDIR
	select BR2_PACKAGE_LUA
	bool "awesome"
	help
	  awesome is an awesome window manager
	  This is the version released by Amazon for Kindle
	  It adds XDamage support to the awesome lua API
```

## system/buildroot_packages/libxdg-basedir/Config.in
```kconfig
config BR2_PACKAGE_LIBXDG_BASEDIR
	bool "libxdg-basedir"
	help
	  libxdg-basedir is an implementation of the 
 	  XDG Base Directory Specification    
 
	  http://standards.freedesktop.org/basedir-spec/basedir-spec-latest.html
```

## system/xdriver_xf86-video-imx/Config.in
```kconfig
config BR2_PACKAGE_XDRIVER_XF86_VIDEO_IMX
	bool "xf86-video-imx"
	select BR2_PACKAGE_XPROTO_FONTSPROTO
	select BR2_PACKAGE_XPROTO_RANDRPROTO
	select BR2_PACKAGE_XPROTO_RENDERPROTO
	select BR2_PACKAGE_XPROTO_XPROTO
	help
	  IMX video driver
```
